## drivers/sensor_node/zephyr/Kconfig
```kconfig
# Copyright (c) 2019 Nordic Semiconductor
# SPDX-License-Identifier: Apache-2.0

config SENSOR_NODE
	bool "Support for the demonstration out of tree driver"
```
